long finalPos;
long destination;
long dPos;
int interval = 30000;
int toneFr = 1000;
unsigned long previousMillis = 0;
unsigned long currentMillis;
int errorTime = 6000;
boolean flag = false;

// SoftwareSerial - Version: Latest 
#include <SoftwareSerial.h>
const int txPin = 2;
const int rxPin = 3;

SoftwareSerial ESP(txPin, rxPin);

// AccelStepper - Version: Latest 
#include <AccelStepper.h>
const int dirPin = 5;
const int stepPin = 6;
const int ePin = 4;
const int home = 7;

AccelStepper stepper(1, stepPin, dirPin);

void setup() {
    pinMode(stepPin, OUTPUT);
    pinMode(dirPin, OUTPUT);
    pinMode(ePin, OUTPUT);
    pinMode(home, INPUT);
    for (int i=8; i < 12; i++) {
      pinMode(i, INPUT);  
    }
    stepper.setMaxSpeed(1000);
    stepper.setAcceleration(1000);
    stepper.setEnablePin(4);
    stepper.setPinsInverted(dirPin);
    stepperInit();
}

void loop() { 
    unsigned long currentMillis = millis();
    if(digitalRead(9) == HIGH) {
        previousMillis = currentMillis;
        flag = true;
        destination = 2000; 
        stepper.enableOutputs();
        stepper.runToNewPosition(destination);
        stepper.disableOutputs();
        tone(2, toneFr, 500);
        errorTime = 3500;
    }
    if(digitalRead(8) == HIGH) {
        previousMillis = currentMillis;
        flag = true;
        destination = 4300; 
        stepper.enableOutputs();
        stepper.runToNewPosition(destination);
        stepper.disableOutputs();
        tone(2, toneFr, 500);
        errorTime = 6000;
    }
    if(digitalRead(10) == HIGH) {
       previousMillis = currentMillis;
        flag = true;
        destination = 50; 
        stepper.enableOutputs();
        stepper.runToNewPosition(destination);
        stepper.disableOutputs();
        tone(2, toneFr, 500);
        errorTime = 1000;
    }
    if(digitalRead(11) == HIGH) {
        stepperHome();
    }
    if ((unsigned long)(currentMillis - previousMillis) >= interval && flag == true) {
      stepperHome();
      flag = false;
      previousMillis = currentMillis;
      tone(2, tone, 1000);
    }
}
void stepperInit() {
    stepper.enableOutputs();
    stepper.runToNewPosition(50);
    stepper.disableOutputs();
    stepperHome();
}

void stepperHome() {
    stepper.enableOutputs();
    stepper.setSpeed(-8000);
    delay(500);
    int counter = 0;
    while (digitalRead(home) == LOW) {
        stepper.runSpeed();
        delay(1);
        counter++;
        if (counter > errorTime) {
          stepper.disableOutputs();
          while (digitalRead(11) == LOW) {
            tone(2, tone, 10);
          }
          stepperHome();
        }
    }
    stepper.setCurrentPosition(0);
    Serial.println(stepper.currentPosition());
    stepper.disableOutputs();
}
